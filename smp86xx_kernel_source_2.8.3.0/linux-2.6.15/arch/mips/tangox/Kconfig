## smp86xx_toolchain_2.8.2.0/toolchain/binutils/Config.in
```kconfig
# Choose binutils version.

comment "Binutils Options"

choice
	prompt "Binutils Version"
	default BR2_BINUTILS_VERSION_2_16_1
	help
          Select the version of binutils you wish to use.

	config BR2_BINUTILS_VERSION_2_15_91_0_2
		bool "binutils 2.15.91.0.2"

#	config BR2_BINUTILS_VERSION_2_16_1
#		bool "binutils 2.16.1"

	config BR2_BINUTILS_VERSION_2_17
		bool "binutils 2.17"
endchoice 

config BR2_BINUTILS_VERSION
	string
	default "2.15.91.0.2"     if BR2_BINUTILS_VERSION_2_15_91_0_2
#	default "2.16.1"          if BR2_BINUTILS_VERSION_2_16_1
	default "2.17"            if BR2_BINUTILS_VERSION_2_17

config BR2_BINUTILS_VERSION
	string
	default "2.15.91.0.2"     if BR2_BINUTILS_VERSION_2_15_91_0_2
#	default "2.16.1"          if BR2_BINUTILS_VERSION_2_16_1
	default "2.17"            if BR2_BINUTILS_VERSION_2_17
```

## smp86xx_toolchain_2.8.2.0/toolchain/ccache/Config.in
```kconfig
#

comment "Ccache Options"

config BR2_CCACHE
	bool "Enable ccache"
	default y
	help
	    Enable ccache support?
```

## smp86xx_toolchain_2.8.2.0/toolchain/gcc/Config.in
```kconfig
# Choose gcc version.

comment "Gcc Options"

choice
	prompt "GCC compiler version"
	default BR2_GCC_VERSION_3_4_2
	help
	  Select the version of gcc.

	config BR2_GCC_VERSION_3_4_2
		bool "gcc 3.4.2"

#	config BR2_GCC_VERSION_3_4_6
#		bool "gcc 3.4.6"

#	config BR2_GCC_VERSION_4_0_3
#		bool "gcc 4.0.3"

	config BR2_GCC_VERSION_4_0_4
		bool "gcc 4.0.4"

#	config BR2_GCC_VERSION_4_1_2
#		bool "gcc 4.1.2"

endchoice

config BR2_GCC_VERSION
	string
	default "3.4.2"     if BR2_GCC_VERSION_3_4_2
#	default "3.4.6"     if BR2_GCC_VERSION_3_4_6
#	default "4.0.3"     if BR2_GCC_VERSION_4_0_3
	default "4.0.4"     if BR2_GCC_VERSION_4_0_4
#	default "4.1.2"     if BR2_GCC_VERSION_4_1_2

config BR2_GCC_USE_SJLJ_EXCEPTIONS
	string
	default "--enable-sjlj-exceptions"
	help
	    Currently the unwind stuff seems to work for staticly linked apps
	    but not dynamic.  So use setjmp/longjmp exceptions by default.

config BR2_EXTRA_GCC_CONFIG_OPTIONS
	string "Additional gcc options"
	default ""
	help
	    Any additional gcc options you may want to include....

config BR2_INSTALL_LIBSTDCPP
	bool
	default y
	help
	    Build/install c++ compiler and libstdc++?

config BR2_INSTALL_LIBGCJ
	bool
	default n
	depends on BR2_INSTALL_LIBSTDCPP
	help
	    Build/install java compiler and libgcj?

config BR2_INSTALL_OBJC
	bool
	default n
	help
	    Build/install Objective-C compiler and runtime?
```

## smp86xx_toolchain_2.8.2.0/toolchain/gdb/Config.in
```kconfig
comment "Gdb Options"

config BR2_PACKAGE_GDB_CLIENT
	bool
	default y
	help
	    Build gdb to run on the host to debug programs running on the target.

choice
	prompt "GDB Version"
	default BR2_GDB_VERSION_6_3
	help
          Select the version of gdb you wish to use.

	config BR2_GDB_VERSION_6_3
		bool "gdb 6.3"

	config BR2_GDB_VERSION_6_5
		bool "gdb 6.5"

endchoice 

config BR2_GDB_VERSION
	string
	default "6.3"      if BR2_GDB_VERSION_6_3
	default "6.5"      if BR2_GDB_VERSION_6_5
```

## smp86xx_toolchain_2.8.2.0/toolchain/uClibc/Config.in
```kconfig
# Choose uClibc options
#

comment "uClibc Options"

choice
	prompt "uClibc Version"
	default BR2_UCLIBC_VERSION_0_9_27
	help
          Select the version of uClibc you wish to use.

	config BR2_UCLIBC_VERSION_0_9_27
		bool "uClibc 0.9.27"

	config BR2_UCLIBC_VERSION_0_9_28
		bool "uClibc 0.9.28.3"

endchoice 

config BR2_UCLIBC_VERSION
	string
	default "0.9.27"     if BR2_UCLIBC_VERSION_0_9_27
	default "0.9.28"     if BR2_UCLIBC_VERSION_0_9_28

#config BR2_UCLIBC_VERSION_SNAPSHOT
#	bool
#	default n
#	help
#	    Would you like to use the latest daily snapshot?

#config BR2_USE_UCLIBC_SNAPSHOT
#	string
#	default "snapshot"
#	depends on BR2_UCLIBC_VERSION_SNAPSHOT

#config BR2_ENABLE_LOCALE
#	bool "Enable locale/gettext/i18n support?"
#	default n
#	help
#	    Enable locale/gettext/i18n support?
```
